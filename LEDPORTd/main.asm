;
; LEDPORTd.asm
;
; Created: 01-02-2023 05:18:19
; Author : Admin
;


; Replace with your application code


		.INCLUDE "M32DEF.INC"
		LDI R20,HIGH(RAMEND)
		OUT SPH,R20
		LDI R20,LOW(RAMEND)
		OUT SPL,R20
		LDI R20,0XFF
		OUT DDRD,R20
		CBI DDRB,3	
		SBI DDRC,5
L1:		SBIC PINB,3
		RJMP L1
		SBI PORTC,5
		CALL DELAY_1S
		CBI PORTC,5
		SBI PORTD,0
		CALL DELAY_1S
		SBI PORTD,1
		CALL DELAY_1S
		SBI PORTD,2
		CALL DELAY_1S
		SBI PORTD,3
		CALL DELAY_1S
		SBI PORTD,4
		CALL DELAY_1S
		SBI PORTD,5
		CALL DELAY_1S
		SBI PORTD,6
		CALL DELAY_1S
		SBI PORTD,7
		CALL DELAY_1S
		LDI R16,0X00
		OUT PORTD,R16
		CALL DELAY_1S
		RJMP L1
	;;*************DELAY1_s*************;

DELAY_1S:	LDI R20,16			;USE 32 INSTEAD 1 FOR PROPER 1 SEC
D1		:	LDI R21,100		;;USE 200 INSTEAD 1 FOR PROPER 1 SEC
D2		:	LDI R22,125	;;USE 250 INSTEAD 1 FOR PROPER 1 SEC
D3		:	NOP
			NOP
			DEC R22
			BRNE D3
			DEC R21
			BRNE D2
			DEC R20
			BRNE D1
			RET